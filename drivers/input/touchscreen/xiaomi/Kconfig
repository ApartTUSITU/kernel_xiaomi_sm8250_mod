## drivers/input/touchscreen/xiaomi/Kconfig
```kconfig
config TOUCHSCREEN_XIAOMI_TOUCHFEATURE
	tristate "Xiaomi Touch Feature"
	depends on INPUT_TOUCHSCREEN
	help
	  Say Y here if you enable xiaomi touch feature.

	  If unsure, say N.

	  To compile this driver as a module, choose M here:

config TOUCHSCREEN_SUPPORT_NEW_GAME_MODE
	bool "Touch Support New Game Mode"
	help
	  Say Y here if the device support new game mode

	  If not support, say N.

config TOUCHSCREEN_NEW_PEN_CONNECT_STRATEGY
	bool "New pen connect strategy"
	depends on TOUCHSCREEN_XIAOMI_TOUCHFEATURE
	help
	  Say Y here if you enable new pen connect strategy.

	  If unsure, say N.

config TOUCHSCREEN_XIAOMI_LHBM
	bool "Xiaomi LHBM Control"
	depends on TOUCHSCREEN_XIAOMI_TOUCHFEATURE
	help
	  Say Y here if you want to enable LHBM control for Xiaomi devices.

	  This adds sysfs interface to control Local HBM functionality.

	  If unsure, say N.
```
